## drivers/platform/x86/intel/tdx/Kconfig
```kconfig
# SPDX-License-Identifier: GPL-2.0-only
#
# X86 TDX Platform Specific Drivers
#

config INTEL_TDX_ATTESTATION
	tristate "Intel TDX attestation driver"
	depends on INTEL_TDX_GUEST
	help
	  The TDX attestation driver provides IOCTL interfaces to the user to
	  request TDREPORT from the TDX module or request quote from the VMM
	  or to get quote buffer size. It is mainly used to get secure disk
	  decryption keys from the key server.
```
