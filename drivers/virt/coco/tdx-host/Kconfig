## drivers/virt/coco/tdx-host/Kconfig
```kconfig
config TDX_HOST_SERVICES
	tristate
	depends on INTEL_TDX_HOST
	depends on INTEL_IOMMU
	select FW_LOADER
	select FW_UPLOAD
	select PCI_TSM if PCI
	default m
```
